## conf/layer.conf
```bitbake
# We have a conf and classes directory, add to BBPATH
BBPATH .= ":${LAYERDIR}"

# We have a packages directory, add to BBFILES
BBFILES += "${LAYERDIR}/recipes-*/*/*.bb \
            ${LAYERDIR}/recipes-*/*/*.bbappend"

BBFILE_COLLECTIONS += "adlink-nvidia"
BBFILE_PATTERN_adlink-nvidia = "^${LAYERDIR}"
BBFILE_PRIORITY_adlink-nvidia = "50"

LAYERVERSION_adlink-nvidia = "1"
LAYERDEPENDS_adlink-nvidia = "tegra"
LAYERSERIES_COMPAT_adlink-nvidia = "dunfell gategarth hardknott"
```
